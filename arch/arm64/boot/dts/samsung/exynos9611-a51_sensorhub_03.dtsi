/*
 * SAMSUNG EXYNOS9611 board device tree source
 *
 * Copyright (c) 2018 Samsung Electronics Co., Ltd.
 *		http://www.samsung.com
 *
 * This program is free software; you can redistribute it and/or modify
 * it under the terms of the GNU General Public License version 2 as
 * published by the Free Software Foundation.
 */

#include <dt-bindings/clock/exynos9610.h>

&contexthub_0 {
	os-type = "sensorhub/shub_exynos9611_a51.fw";
	/* chub irq pin lists */
	chub-irq-pin-len = <0>;
	chub-irq-pin = <>;
	clocks =
		/* SHUB */
		<&clock UMUX_CLKCMU_SHUB_BUS>,
		/* MAG, PROXI, BARO are all I2C */
		<&clock CMGP_I2C>;
	clock-names =
		"chub_bus",
		"cmgp_i2c";

	sensor-ldo-en = <&gpm24 0 1>;
	mag-check-nfc = <&gpg0 3 0>;
	mag-check-mst = <&gpg0 1 0>;
	
	/* SSP */
	ssp-acc-position = <4>;
	ssp-mag-position = <3>;
	ssp-prox-thresh-addval = /bits/ 16 <80 20 30>;
	ssp-mag-array = /bits/ 8 <156 80 198 130 147 46 0 254 214
		55 75 236 217 211 254 6 254 110
		146 165 192 252 237 69 8 230 223>;
	ssp-mag-nfc-array = /bits/ 8 <217 85 29 111 206 233 1 139 208
		54 186 162 170 179 252 179 3 126
		248 143 190 255 42 254 8 5 76>;
	ssp-mag-mst-array = /bits/ 8 <153 88 189 111 71 232 1 139 202 
		54 186 222 255 179 250 179 5 61
		227 133 188 4 3 234 8 5 96>;
	ssp-light-position = /bits/ 32 <51 81 2 59 1 8>;
	ssp-light-cam-lux = /bits/ 32 <100 200>;
	ssp-light-cam-br = /bits/ 32 <60 60>;
};
