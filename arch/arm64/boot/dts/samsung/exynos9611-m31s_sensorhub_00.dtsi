/*
 * SAMSUNG EXYNOS9610 board device tree source
 *
 * Copyright (c) 2018 Samsung Electronics Co., Ltd.
 *		http://www.samsung.com
 *
 * This program is free software; you can redistribute it and/or modify
 * it under the terms of the GNU General Public License version 2 as
 * published by the Free Software Foundation.
 */

#include <dt-bindings/clock/exynos9610.h>

&contexthub_0 {
	os-type = "sensorhub/shub_ramen_m31s.fw";
	/* chub irq pin lists */
	chub-irq-pin-len = <0>;
	chub-irq-pin = <>;
	clocks =
		/* SHUB */
		<&clock UMUX_CLKCMU_SHUB_BUS>,
		/* MAG, PROXI, BARO are all I2C */
		<&clock CMGP_I2C>;
	clock-names =
		"chub_bus",
		"cmgp_i2c";

	sensor-ldo-en = <&gpm21 0 1>;

	/* SSP */
	ssp-acc-position = <3>;
	ssp-mag-position = <3>;
	ssp-mag-array = /bits/ 8 <3 225 255 242 0 19 255 215 3 185 255 245 255 230 255 250 4 9 0 0 0 0 0 0 0 0>;
	ssp-light-position = /bits/ 32 <52 5 3 28 1 8>;
	ssp-light-cam-lux = /bits/ 32 <100 200>;
	ssp-light-cam-br = /bits/ 32 <60 60>;
	ssp-brightness-array-len = <5>;
	ssp-brightness-array = /bits/ 32 <15 40 50 77 255>;
};
