/*
 * SAMSUNG EXYNOS9610 board device tree source
 *
 * Copyright (c) 2018 Samsung Electronics Co., Ltd.
 *		http://www.samsung.com
 *
 * This program is free software; you can redistribute it and/or modify
 * it under the terms of the GNU General Public License version 2 as
 * published by the Free Software Foundation.
 */

/dts-v1/;
/plugin/;
#include "exynos9611-m31s_common.dtsi"
#include "exynos9611-m31s_sea_open_sensorhub_00.dtsi"
#include "exynos9611-m31s_nfc_00.dtsi"
#include "exynos9611-m31s_sea_open_gpio_00.dtsi"
#include "exynos9611-m31s_fingerprint_00.dtsi"
#include "exynos9611-m31s_sea_open_sensor_grip_00.dtsi"

/ {
	compatible = "samsung, M31S SEA OPEN REV00", "samsung,EXYNOS9611";
	dtbo-hw_rev = <0>;
	dtbo-hw_rev_end = <255>;

	fragment@model {
		target-path = "/";
		__overlay__ {
			#address-cells = <2>;
			#size-cells = <1>;

			model = "Samsung M31S SEA OPEN REV00 board based on Exynos9611";

			mif_pdata {
				/* GPIOs for HW REV */
				/* XGPIO26-AP_REV0, XGPIO27-AP_REV1, XGPIO28-AP_REV2, XGPIO29-AP_REV3 */
				gpios = <&gpg3 2 0>, <&gpg3 3 0>, <&gpg3 4 0>, <&gpg3 5 0>;
				pinctrl-names = "default";
			};

		}; /* end of __overlay__ */
	}; /* end of fragment */
}; /* end of root */
