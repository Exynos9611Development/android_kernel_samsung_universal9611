/*
 * SAMSUNG EXYNOS9611 board device tree source
 *
 * Copyright (c) 2018 Samsung Electronics Co., Ltd.
 *		http://www.samsung.com
 *
 * This program is free software; you can redistribute it and/or modify
 * it under the terms of the GNU General Public License version 2 as
 * published by the Free Software Foundation.
 */

#include <dt-bindings/clock/exynos9610.h>

&contexthub_0 {
	os-type = "sensorhub/shub_exynos9611_a51.fw";
	/* chub irq pin lists */
	chub-irq-pin-len = <0>;
	chub-irq-pin = <>;
	clocks =
		/* SHUB */
		<&clock UMUX_CLKCMU_SHUB_BUS>,
		/* MAG, PROXI, BARO are all I2C */
		<&clock CMGP_I2C>;
	clock-names =
		"chub_bus",
		"cmgp_i2c";

	sensor-ldo-en = <&gpm24 0 1>;
	mag-check-nfc = <&gpg0 3 0>;
	mag-check-mst = <&gpg0 1 0>;
	
	/* SSP */
	ssp-acc-position = <4>;
	ssp-mag-position = <2>;
	ssp-prox-thresh-addval = /bits/ 16 <80 20 30>;
	ssp-mag-array = /bits/ 8 <0 0 0 0 0 0 0 0 0
		0 0 0 0 0 0 0 0 0
		0 0 0 0 0 0 0 0 0>;
	ssp-mag-mst-array = /bits/ 8 <144 89 229 111 178 147 1 139 206
		54 186 216 140 179 255 179 0 238
		166 121 188 255 30 193 9 5 87>;
	ssp-light-position = /bits/ 32 <51 81 2 59 1 8>;
	ssp-light-cam-lux = /bits/ 32 <100 200>;
	ssp-light-cam-br = /bits/ 32 <60 60>;
};
